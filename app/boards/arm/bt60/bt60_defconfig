## app/boards/arm/bt60/bt60_defconfig
```kconfig
# SPDX-License-Identifier: MIT

CONFIG_SOC_SERIES_NRF52X=y
CONFIG_SOC_NRF52840_QIAA=y
CONFIG_BOARD_BT60=y

# Enable MPU
CONFIG_ARM_MPU=y

# enable GPIO
CONFIG_GPIO=y

CONFIG_PINCTRL=y

CONFIG_ZMK_USB_LOGGING=y

CONFIG_ZMK_TRACKPAD=y
CONFIG_I2C=y
CONFIG_GEN4=y
CONFIG_GEN4_TRIGGER_GLOBAL_THREAD=y
CONFIG_SENSOR_LOG_LEVEL_DBG=y


CONFIG_USE_DT_CODE_PARTITION=y

CONFIG_MPU_ALLOW_FLASH_WRITE=y
CONFIG_NVS=y
CONFIG_SETTINGS_NVS=y
CONFIG_FLASH=y
CONFIG_FLASH_PAGE_LAYOUT=y
CONFIG_FLASH_MAP=y

CONFIG_LOG_BUFFER_SIZE=38000
CONFIG_USB_CDC_ACM_RINGBUF_SIZE=38000
CONFIG_LOG_PROCESS_THREAD_STARTUP_DELAY_MS=8000

CONFIG_BT_CTLR_TX_PWR_PLUS_8=y

CONFIG_BUILD_OUTPUT_UF2=y
```

## app/drivers/zephyr/dts/bindings/sensor/azoteq,pxm.yaml
```yaml
description: |
  Sensor driver for the Azoteq PXM I2C trackpad ASICs

compatible: "azoteq,pxm"

include: ["i2c-device.yaml"]

properties:
  dr-gpios:
    type: phandle-array
    description: Data ready pin for the trackpad
  rotate-90:
    type: boolean
  sleep:
    type: boolean
  no-taps:
    type: boolean
```
